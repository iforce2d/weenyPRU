
#include "main.h"
#include "rgbled.h"
#include "spi1_rgbled.h"
#include "config.h"
#include "comms.h"

#ifdef USE_RGBLED

#define NUM_RGBLEDS 16

uint8_t rgbBytes[ NUM_RGBLEDS * 9 + 2 ];

const uint8_t gammaTable[] = {
    0,  0,  0,  0,  0,  0,  0,  0,  0,  0,  0,  0,  0,  0,  0,  0,
    0,  0,  0,  0,  0,  0,  0,  0,  0,  0,  0,  0,  1,  1,  1,  1,
    1,  1,  1,  1,  1,  1,  1,  1,  1,  2,  2,  2,  2,  2,  2,  2,
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  215,218,220,223,225,228,231,233,236,239,241,244,247,249,252,255 };


const uint8_t encoderLookup[256*3]={
		0x92,0x49,0x24,0x92,0x49,0x26,0x92,0x49,0x34,0x92,0x49,0x36,0x92,0x49,0xA4,0x92,
		0x49,0xA6,0x92,0x49,0xB4,0x92,0x49,0xB6,0x92,0x4D,0x24,0x92,0x4D,0x26,0x92,0x4D,
		0x34,0x92,0x4D,0x36,0x92,0x4D,0xA4,0x92,0x4D,0xA6,0x92,0x4D,0xB4,0x92,0x4D,0xB6,
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		0x34,0xDB,0x6D,0x36,0xDB,0x6D,0xA4,0xDB,0x6D,0xA6,0xDB,0x6D,0xB4,0xDB,0x6D,0xB6};

void turnOffAllRGBLEDs() {
	for (uint16_t i = 0; i < NUM_RGBLEDS; i++) {
		setRGBLedColor(i, 0,0,0); // memset zero does not work here
	}
}

void initRGBLED() {

	// first and last byte need to be zero
	rgbBytes[0] = 0;
	rgbBytes[NUM_RGBLEDS * 9 + 1] = 0;

	turnOffAllRGBLEDs();

	MX_SPI1_Init_rgbled();

}

void setRGBLedColor(uint16_t n, uint8_t r, uint8_t g, uint8_t b) {

	if ( n >= NUM_RGBLEDS )
		return;

	r = gammaTable[r];
	g = gammaTable[g];
	b = gammaTable[b];

	uint8_t *bptr = rgbBytes + n*9 + 1;
	uint8_t *tPtr = (uint8_t *)encoderLookup + 3*g;

	*bptr++ = *tPtr++;
	*bptr++ = *tPtr++;
	*bptr++ = *tPtr++;

	tPtr = (uint8_t *)encoderLookup + 3*r;
	*bptr++ = *tPtr++;
	*bptr++ = *tPtr++;
	*bptr++ = *tPtr++;

	tPtr = (uint8_t *)encoderLookup + 3*b;
	*bptr++ = *tPtr++;
	*bptr++ = *tPtr++;
	*bptr++ = *tPtr++;
}

void updateRGBLEDs() {

	uint8_t brightness = 100;
	uint8_t rgb[3];

    for (int i = 0; i < 48; i++)
    {
        int bytePos = i / 8;
        int bitPos = i % 8;
    	int ledPos = i / 3;
    	int colorPos = i % 3;

    	if ( rxData.rgb[bytePos] & (1 << bitPos))
        	rgb[colorPos] = brightness;
        else
        	rgb[colorPos] = 0;

        if ( colorPos == 2 )
        	setRGBLedColor(ledPos, rgb[0], rgb[1], rgb[2]);
    }
}

extern SPI_HandleTypeDef hspi1;

void doRGBLEDOutput() {

	HAL_SPI_Transmit_DMA( &hspi1, rgbBytes, NUM_RGBLEDS * 9 + 2 );

}

#endif
